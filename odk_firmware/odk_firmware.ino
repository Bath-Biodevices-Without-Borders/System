//will not work with default plugins 
//you must change: Tools, Pin numbering : "by GPIO number (legacy)""

#undef pinMode
#include <MCP23017.h>
#include <Wire.h>
#include <SPI.h>
#include <Adafruit_GFX.h>
#include <Adafruit_SSD1306.h>
#include <stdint.h>
#include <ArduinoBLE.h>

#include "odk_gps.h"
#include "odk_ble.h"
#include "odk_temp_sensor.h"
#include "odk_battery.h"
#include "odk_analysis.h"      // <-- analysis mode

extern TinyGPSPlus gps;
extern BLECharacteristic anlgCh0Chstic;
extern BLECharacteristic anlgCh1Chstic;

#define SCREEN_WIDTH  128
#define SCREEN_HEIGHT  64

#define OLED_MOSI  38
#define OLED_CLK   48
#define OLED_DC    18
#define OLED_CS    21
#define OLED_RESET 17

#define GPS_RX 43
#define GPS_TX 44

#define SR_DATA  7
#define SR_LATCH 9
#define SR_CLOCK 8

Adafruit_SSD1306 display(SCREEN_WIDTH, SCREEN_HEIGHT,
  OLED_MOSI, OLED_CLK, OLED_DC, OLED_RESET, OLED_CS);

uint16_t analogue_0 = 0;
uint16_t analogue_1 = 0;
float    temperature = 0;

#define ODK_SPLASH_HEIGHT 64
#define ODK_SPLASH_WIDTH 128

static const uint8_t PROGMEM ODK_splash[] = {
    0b00000000, 0b00000000, 0b00000000, 0b00000000, 0b00000000, 0b00000000, 0b00000000, 0b00000000, 0b00000000, 0b00000000, 0b00000000, 0b00000000, 0b00000000, 0b00000000, 0b00000000, 0b00000000, 
    0b00000000, 0b00000000, 0b00000000, 0b00000000, 0b00000000, 0b00000000, 0b00000000, 0b00000000, 0b00000000, 0b00000000, 0b00000000, 0b00000000, 0b00000000, 0b00000000, 0b00000000, 0b00000000, 
    0b00000000, 0b00000000, 0b00000000, 0b00000000, 0b01110000, 0b00000000, 0b00000000, 0b00000000, 0b00000000, 0b00000000, 0b00000000, 0b00000000, 0b00000000, 0b00000000, 0b00000000, 0b00000000, 
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    0b00000000, 0b00000000, 0b00000000, 0b00000000, 0b00000000, 0b00000000, 0b00000000, 0b00000000, 0b00000000, 0b00000000, 0b00000000, 0b00000000, 0b00000000, 0b00000000, 0b00000000, 0b00000000
};

#define MCP23017_ADDR 0x20
MCP23017 mcp = MCP23017(MCP23017_ADDR);

bool bit3Prev = false;

void setup() {
    if (!display.begin(SSD1306_SWITCHCAPVCC)) {
        Serial.println(F("SSD1306 allocation failed"));
        for (;;);
    }
    display.clearDisplay();
    display.drawBitmap(0, 0, ODK_splash, ODK_SPLASH_WIDTH, ODK_SPLASH_HEIGHT, 1);
    display.display();
    for (int i = 0; i < 8; i++) {
        delay(100);
        display.invertDisplay(1);
        delay(100);
        display.invertDisplay(0);
    }

    Wire.begin();
    Serial.begin(115200);

    mcp.init();
    mcp.portMode(MCP23017Port::A, 0);
    mcp.portMode(MCP23017Port::B, 0b11111111);
    mcp.writeRegister(MCP23017Register::GPIO_A, 0x00);
    mcp.writeRegister(MCP23017Register::GPIO_B, 0x00);
    mcp.writeRegister(MCP23017Register::IPOL_B, 0x00);

    display.setTextSize(1);
    display.setTextColor(SSD1306_WHITE);

    srInit();
    wire_init();
    ble_init();
    gps_init();
    gps_poll(true);
}

uint8_t mux_sel   = 0;
uint8_t mux_sel_r = 0;

void loop() {
    uint8_t currentB = mcp.readPort(MCP23017Port::B);

    gps_poll();
    ble_poll();

    // --- Button 3 edge detection (active LOW) ---
    bool bit3Now = !(currentB & (1 << 3));
    if (bit3Now && !bit3Prev) {
        if (!inAnalysis) {
            enterAnalysis();
        } else {
            inAnalysis = false;   // early exit
        }
        delay(200);               // debounce
    }
    bit3Prev = bit3Now;

    // --- Analysis mode ---
    if (inAnalysis) {
        runAnalysis(display);
        return;
    }

    // --- Normal operation ---
    srDriveAllBits(~currentB);
    if (mux_sel < 8) {
        if (0x01 & ~currentB) {
            mux_sel += 1;
            delay(250);
        }
    } else {
        mux_sel = 0;
    }

    mux_sel_r = reverseBits(mux_sel, 3);
    mcp.writeRegister(MCP23017Register::GPIO_A, mux_sel_r);

    char anlg0string[5] = "9999";
    char anlg1string[5] = "9999";
    analogue_0  = analogRead(1);
    analogue_1  = analogRead(2);
    temperature = get_temp();
    sprintf(anlg0string, "%4d", analogue_0);
    sprintf(anlg1string, "%4d", analogue_1);
    anlgCh0Chstic.writeValue((byte*)anlg0string, 4);
    anlgCh1Chstic.writeValue((byte*)anlg1string, 4);

    uint16_t batLevel = read_bat_reg(BAT_VCELL);
    uint16_t batDis   = read_bat_reg(BAT_CRATE);

    display.clearDisplay();
    display.setCursor(0, 0);
    display.print(F("Battery level: ")); display.println((float)batLevel * 0.0001559892211404729);
    display.print(F("Battery Dscge: ")); display.print((float)batDis * 0.208); display.println("%");
    display.print(gps.date.year());  display.print(F("/"));
    display.print(gps.date.month()); display.print(F("/"));
    display.print(gps.date.day());   display.print(F("  "));
    display.print(gps.time.hour());  display.print(F(":"));
    display.print(gps.time.minute());display.print(F(":"));
    display.println(gps.time.second());
    display.print(F("Lat: ")); display.print(gps.location.lat());
    display.print(F(", Lon: ")); display.println(gps.location.lng());
    display.println();
    display.print(F("Analogue Port: ")); display.println(mux_sel);
    display.print(F("A0: ")); display.print(analogue_0); display.print(", ");
    display.print(F("A1: ")); display.println(analogue_1);
    display.print(F("Temp: ")); display.println(temperature);
    display.display();

    if (Serial.available() > 0) {
        String inputStr = Serial.readStringUntil('\n');
        inputStr.trim();
        int spaceIndex = inputStr.indexOf(' ');
        if (spaceIndex == -1) {
            long address = strtol(inputStr.c_str(), NULL, 16);
            Serial.print("Value at ");
            Serial.print((uint8_t)address);
            Serial.print(" = ");
            Serial.println(read_bat_reg((uint8_t)address));
        } else {
            String addressStr = inputStr.substring(0, spaceIndex);
            String dataStr    = inputStr.substring(spaceIndex + 1);
            addressStr.trim(); dataStr.trim();
            long address = strtol(addressStr.c_str(), NULL, 16);
            long data    = strtol(dataStr.c_str(), NULL, 16);
            write_bat_reg((uint8_t)address, (uint16_t)data);
            Serial.print("Wrote ");
            Serial.print((uint16_t)data, HEX);
            Serial.print(" to address ");
            Serial.println((uint8_t)address, HEX);
        }
    }
}

// ============================================================
//  Shift register helpers
// ============================================================

void srInit() {
    pinMode(SR_DATA,  OUTPUT);
    pinMode(SR_LATCH, OUTPUT);
    pinMode(SR_CLOCK, OUTPUT);
    digitalWrite(SR_DATA,  LOW);
    digitalWrite(SR_LATCH, LOW);
    digitalWrite(SR_CLOCK, LOW);
    for (int i = 0; i < 8; i++) {
        digitalWrite(SR_CLOCK, HIGH);
        digitalWrite(SR_CLOCK, LOW);
    }
    digitalWrite(SR_LATCH, HIGH);
    digitalWrite(SR_LATCH, LOW);
}

uint8_t reverseBits(uint8_t num, uint8_t bitSize) {
    uint8_t reversed = 0;
    for (uint8_t i = 0; i < bitSize; i++) {
        if (num & (1 << i)) {
            reversed |= (1 << (bitSize - 1 - i));
        }
    }
    return reversed;
}

void srDriveAllBits(uint8_t bits) {
    uint8_t top_bit;
    for (int i = 0; i < 8; i++) {
        top_bit = bits & 0x80;
        bits    = bits << 1;
        digitalWrite(SR_DATA, top_bit ? HIGH : LOW);
        digitalWrite(SR_CLOCK, HIGH);
        digitalWrite(SR_CLOCK, LOW);
    }
    digitalWrite(SR_LATCH, HIGH);
    digitalWrite(SR_LATCH, LOW);
}
