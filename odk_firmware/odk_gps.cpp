#include <Arduino.h>
#include <ArduinoBLE.h>
#include "odk_gps.h"
#include "odk_ble.h"

// Create GPS abstraction class and UART interface
static const uint32_t gpsBaud = 9600;
SoftwareSerial gpsSerial(43, 44);
TinyGPSPlus gps;

extern BLECharacteristic gpsLatChstic;
extern BLECharacteristic gpsLonChstic;
extern BLECharacteristic gpsTimeChstic;
extern BLECharacteristic gpsDateChstic;

char latString[9];
char lonString[10];
char timeString[9];
char dateString[11];

void gps_init()
{
    gpsSerial.begin(gpsBaud);

    double latitude = gps.location.lat();
    double longitude = gps.location.lng();
    uint8_t hour = gps.time.hour();
    uint8_t minute = gps.time.minute();
    uint8_t second = gps.time.second();
    uint16_t year = gps.date.year();
    uint8_t month = gps.date.month();
    uint8_t day = gps.date.day();

    
    sprintf(timeString, "%02d:%02d:%02d", hour, minute, second);
    sprintf(dateString, "%04d/%02d/%02d", year, month, day);
    sprintf(latString, "%+08.4lf", latitude);
    sprintf(lonString, "%+09.4lf", longitude);


    gpsLatChstic.writeValue((byte*)latString, 8);
    gpsLonChstic.writeValue((byte*)lonString, 9);
    gpsTimeChstic.writeValue((byte*)timeString, 8);
    gpsDateChstic.writeValue((byte*)dateString, 10);
}

void gps_poll(bool force)
{
    while (gpsSerial.available() > 0) {
        char c = gpsSerial.read();
        gps.encode(c); // Parse GPS data

        if (force || gps.location.isUpdated()) {
            double latitude = gps.location.lat();
            double longitude = gps.location.lng();
            // Serial.print("Latitude: ");
            // Serial.println(latitude, 6);
            // Serial.print("Longitude: ");
            // Serial.println(longitude, 6);

            sprintf(latString, "%+08.4lf", latitude);
            sprintf(lonString, "%+09.4lf", longitude);
            gpsLatChstic.writeValue((byte*)latString, 8);
            gpsLonChstic.writeValue((byte*)lonString, 9);
        }

        if (force || gps.time.isUpdated()) {
            uint8_t hour = gps.time.hour();
            uint8_t minute = gps.time.minute();
            uint8_t second = gps.time.second();
            // Serial.print("Time (UTC): ");
            // Serial.print(hour);
            // Serial.print(":");
            // Serial.print(minute);
            // Serial.print(":");
            // Serial.println(second);

            sprintf(timeString, "%02d:%02d:%02d", hour, minute, second);
            gpsTimeChstic.writeValue((byte*)timeString, 8);
        }

        if (force || gps.date.isUpdated()) {
            uint16_t year = gps.date.year();
            uint8_t month = gps.date.month();
            uint8_t day = gps.date.day();
            // Serial.print("Date (UTC): ");
            // Serial.print(year);
            // Serial.print("/");
            // Serial.print(month);
            // Serial.print("/");
            // Serial.println(day);

            sprintf(dateString, "%04d/%02d/%02d", year, month, day);
            gpsDateChstic.writeValue((byte*)dateString, 10);
        }
    }
}

int gps_command(char cmd)
{
    const uint8_t baud9600[37] =  {0xb5,0x62,0x06,0x00,0x14,0x00,0x01,0x00,0x00,0x00,0xd0,0x08,0x00,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0x08,0x22};
    const uint8_t oneHz[14] =     {0xB5, 0x62, 0x06, 0x08, 0x06, 0x00, 0xE8, 0x03, 0x01, 0x00, 0x01, 0x00, 0x01, 0x39};
    const uint8_t fiveHz[22] =    {0xB5, 0x62, 0x06, 0x08, 0x06, 0x00, 0xC8, 0x00, 0x01, 0x00, 0x01, 0x00, 0xDE, 0x6A, 0xB5, 0x62, 0x06, 0x08, 0x00, 0x00, 0x0E, 0x30};
    const uint8_t reset[12] =     {0xB5, 0x62, 0x06, 0x04, 0x04, 0x00, 0xFF, 0x87, 0x01, 0x00, 0x95, 0xF7};
    const uint8_t coldStart[12] = {0xB5, 0x62, 0x06, 0x04, 0x04, 0x00, 0xFF, 0xFF, 0x02, 0x00, 0x0E, 0x61};
    const uint8_t enOuts1[155] =  {0x24, 0x45, 0x49, 0x47, 0x50, 0x51, 0x2c, 0x44, 0x54, 0x4d, 0x2a, 0x33, 0x42,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 0xfd, 0x14};
    const uint8_t enOuts2[130] =  {0x24, 0x45, 0x49, 0x47, 0x50, 0x51, 0x2c, 0x47, 0x53, 0x54, 0x2a, 0x32, 0x36,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 0x03, 0x20};
    const uint8_t save[21] = {0xB5, 0x62, 0x06, 0x09, 0x0D, 0x00, 0x00, 0x00, 0x00, 0x00, 0xFF, 0xFF, 0x00, 0x00, 0x00, 0x00, 0x00, 0x00, 0x17, 0x31, 0xBF};
    const uint8_t res2manuf[21] = {0xB5, 0x62, 0x06, 0x09, 0x0D, 0x00, 0xFF, 0xFF, 0x00, 0x00, 0x00, 0x00, 0x00, 0x00, 0xFF, 0xFF, 0x00, 0x00, 0x07, 0x1F, 0x9E};
    const uint8_t * buf;
    uint16_t len;
    
    switch(cmd) {
    case ('a'):
        buf = baud9600;
        len = 37;
        break;
    case('b'):
        buf = oneHz;
        len = 14;
        break;
    case('c'):
        buf = fiveHz;
        len = 22;
        break;
    case('r'):
        buf = reset;
        len = 12;
        break;
    case('s'):
        buf = coldStart;
        len = 12;
        break;
    case('e'):
        buf = enOuts1;
        len = 155;
        break;
    case('w'):
        buf = enOuts2;
        len = 130;
        break;
    case('p'):
        buf = save;
        len = 21;
        break;
    case('m'):
        buf = res2manuf;
        len = 21;
        break;
    default:
        return 0;
    }
    gpsSerial.write(buf, len);
    return 1;
}